## sdkconfig.defaults
```kconfig
CONFIG_IDF_TARGET="esp32s3"
CONFIG_IDF_TARGET_ESP32S3=y

# Use custom partition table
CONFIG_PARTITION_TABLE_CUSTOM=y
CONFIG_PARTITION_TABLE_CUSTOM_FILENAME="partitions.csv"
CONFIG_PARTITION_TABLE_OFFSET=0x8000

# Flash configuration (adjust based on your board)
# CONFIG_ESPTOOLPY_FLASHSIZE_4MB=y # Uncomment if using 4MB flash
CONFIG_ESPTOOLPY_FLASHSIZE_8MB=y  
CONFIG_ESPTOOLPY_FLASHSIZE="8MB"

CONFIG_ESPTOOLPY_BEFORE="default_reset"
CONFIG_ESPTOOLPY_AFTER_RESET=y
# CONFIG_ESPTOOLPY_AFTER_NORESET is not set
CONFIG_ESPTOOLPY_AFTER="hard_reset"
CONFIG_ESPTOOLPY_MONITOR_BAUD=460800


CONFIG_ESPTOOLPY_FLASHMODE_DIO=y     # Common, safe flash mode
CONFIG_ESPTOOLPY_FLASHFREQ_80M=y

# Optional: Set main task stack size (increase if using large tasks)
# CONFIG_ESP_MAIN_TASK_STACK_SIZE=4096
```
